## drivers/input/fingerprint/Kconfig
```kconfig
#
# Fingerprint driver configuration
#

config INPUT_FINGERPRINT
	bool "Fingerprints"
	help
	  Say Y here, and a list of supported fingerprints will be displayed.
	  This option doesn't affect the kernel.

	  If unsure, say Y.

config FPC_FINGERPRINT
	tristate "fpc1020 fingerprint driver"
	depends on INPUT_FINGERPRINT
	default n
	help
	add support for FPC fingerprint driver.

config GOODIX_FINGERPRINT
	tristate "generic goodix fingerprint driver"
	depends on INPUT_FINGERPRINT
	default n
	help
	add support for goodix fingerprint driver.
config FINGERPRINT_FP_VREG_CONTROL
    bool "fingerprint fp_vdd_reg regulator control"
    default n
	help
	  Say Y here to enable fp_vdd_vreg regulator by device driver

menuconfig INPUT_FINGERPRINT
	bool "Fingerprints"
	help
	  Say Y here, and a list of supported fingerprints will be displayed.
	  This option doesn't affect the kernel.

	  If unsure, say Y.

if INPUT_FINGERPRINT
source "drivers/input/fingerprint/mi_fp/Kconfig"
endif
```

## drivers/xiaomi/Kconfig
```kconfig
source "drivers/xiaomi/dump_display/Kconfig"
source "drivers/xiaomi/bootmonitor/Kconfig"
```
